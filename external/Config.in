## external/Config.in
```kconfig
source "$BR2_EXTERNAL_TINCAN_PATH/package/inn2/Config.in"
source "$BR2_EXTERNAL_TINCAN_PATH/package/datatransport/Config.in"
source "$BR2_EXTERNAL_TINCAN_PATH/package/python-gpsd-py3/Config.in"
source "$BR2_EXTERNAL_TINCAN_PATH/package/python-pyephem/Config.in"
source "$BR2_EXTERNAL_TINCAN_PATH/package/python2-numpy/Config.in"
source "$BR2_EXTERNAL_TINCAN_PATH/package/libnfsidmap/Config.in"
source "$BR2_EXTERNAL_TINCAN_PATH/package/nfs-utils-2/Config.in"
source "$BR2_EXTERNAL_TINCAN_PATH/package/mgetty/Config.in"
source "$BR2_EXTERNAL_TINCAN_PATH/package/ts-utils-7250v2/Config.in"
source "$BR2_EXTERNAL_TINCAN_PATH/package/digitemp/Config.in"
source "$BR2_EXTERNAL_TINCAN_PATH/package/set-dynamics-mode/Config.in"
source "$BR2_EXTERNAL_TINCAN_PATH/package/ufw/Config.in"
```

## external/configs/mango-rpi4-v1_defconfig
```kconfig
BR2_aarch64=y
BR2_cortex_a72=y
BR2_ARM_FPU_VFPV4=y
BR2_CCACHE=y
BR2_GLOBAL_PATCH_DIR="$(BR2_EXTERNAL_TINCAN_PATH)/board/mango-rpi4-v1/patches"
BR2_TOOLCHAIN_BUILDROOT_GLIBC=y
BR2_PACKAGE_HOST_LINUX_HEADERS_CUSTOM_5_10=y
BR2_PACKAGE_GLIBC_UTILS=y
BR2_TOOLCHAIN_BUILDROOT_CXX=y
BR2_TARGET_GENERIC_HOSTNAME="tincan.local.net"
BR2_TARGET_GENERIC_ISSUE="Embedded Data Transport System"
BR2_ROOTFS_DEVICE_CREATION_DYNAMIC_EUDEV=y
BR2_ROOTFS_DEVICE_TABLE="$(BR2_EXTERNAL_TINCAN_PATH)/board/mango-rpi4-v1/device_table.txt"
BR2_TARGET_GENERIC_ROOT_PASSWD="$$5$$Ob0Adn6TQ6Woamtg$$Ey38YKPbn4uKX/rlhKLv67m8822z7vO7y0zzqBikWpB"
BR2_SYSTEM_BIN_SH_BASH=y
BR2_SYSTEM_DHCP="eth0"
BR2_ENABLE_LOCALE_WHITELIST="C en_US en_US.utf8"
BR2_GENERATE_LOCALE="en_US"
BR2_ROOTFS_USERS_TABLES="$(BR2_EXTERNAL_TINCAN_PATH)/board/mango-rpi4-v1/users_table.txt"
BR2_ROOTFS_OVERLAY="$(BR2_EXTERNAL_TINCAN_PATH)/board/mango-rpi4-v1/overlay"
BR2_ROOTFS_POST_BUILD_SCRIPT="board/raspberrypi4-64/post-build.sh $(BR2_EXTERNAL_TINCAN_PATH)/board/mango-rpi4-v1/post-build.sh"
BR2_ROOTFS_POST_IMAGE_SCRIPT="$(BR2_EXTERNAL_TINCAN_PATH)/board/mango-rpi4-v1/post-image.sh  board/raspberrypi4-64/post-image.sh"
BR2_ROOTFS_POST_SCRIPT_ARGS="--add-miniuart-bt-overlay --aarch64 --dtoverlay=i2c-rtc,pcf8523 secretsdir=$(BR2_EXTERNAL_TINCAN_PATH)/../secrets"
BR2_LINUX_KERNEL=y
BR2_LINUX_KERNEL_CUSTOM_TARBALL=y
BR2_LINUX_KERNEL_CUSTOM_TARBALL_LOCATION="$(call github,raspberrypi,linux,b657cd2f27d9171b75c846f21e7b4bb581b3ed29)/linux-b657cd2f27d9171b75c846f21e7b4bb581b3ed29.tar.gz"
BR2_LINUX_KERNEL_DEFCONFIG="bcm2711"
BR2_LINUX_KERNEL_DTS_SUPPORT=y
BR2_LINUX_KERNEL_INTREE_DTS_NAME="broadcom/bcm2711-rpi-4-b"
BR2_LINUX_KERNEL_NEEDS_HOST_OPENSSL=y
BR2_PACKAGE_BUSYBOX_CONFIG="$(BR2_EXTERNAL_TINCAN_PATH)/board/mango-rpi4-v1/busybox.config"
BR2_PACKAGE_BUSYBOX_SHOW_OTHERS=y
BR2_PACKAGE_STRACE=y
BR2_PACKAGE_JQ=y
BR2_PACKAGE_AUTOFS=y
BR2_PACKAGE_E2FSPROGS=y
BR2_PACKAGE_E2FSPROGS_RESIZE2FS=y
BR2_PACKAGE_LINUX_FIRMWARE=y
BR2_PACKAGE_LINUX_FIRMWARE_BRCM_BCM43XXX=y
BR2_PACKAGE_RPI_FIRMWARE=y
BR2_PACKAGE_RPI_FIRMWARE_VARIANT_PI4=y
BR2_PACKAGE_APCUPSD=y
BR2_PACKAGE_APCUPSD_APCSMART=y
BR2_PACKAGE_APCUPSD_DUMB=y
BR2_PACKAGE_APCUPSD_MODBUS_USB=y
BR2_PACKAGE_APCUPSD_NET=y
BR2_PACKAGE_APCUPSD_PCNET=y
BR2_PACKAGE_APCUPSD_SNMP=y
BR2_PACKAGE_APCUPSD_USB=y
BR2_PACKAGE_DBUS=y
BR2_PACKAGE_GPSD=y
BR2_PACKAGE_GPSD_DEVICES="/dev/gps0"
BR2_PACKAGE_GPSD_CLIENT_DEBUG=y
BR2_PACKAGE_GPSD_OLDSTYLE=y
BR2_PACKAGE_GPSD_UBX=y
BR2_PACKAGE_I2C_TOOLS=y
BR2_PACKAGE_MINICOM=y
BR2_PACKAGE_PIGPIO=y
BR2_PACKAGE_SETSERIAL=y
BR2_PACKAGE_UHUBCTL=y
BR2_PACKAGE_USBUTILS=y
BR2_PACKAGE_PYTHON_PY_PYC=y
BR2_PACKAGE_PYTHON_2TO3=y
BR2_PACKAGE_PYTHON_BZIP2=y
BR2_PACKAGE_PYTHON_BSDDB=y
BR2_PACKAGE_PYTHON_CURSES=y
BR2_PACKAGE_PYTHON_READLINE=y
BR2_PACKAGE_PYTHON_SQLITE=y
BR2_PACKAGE_PYTHON_DATEUTIL=y
BR2_PACKAGE_PYTHON_FLASK=y
BR2_PACKAGE_PYTHON_PIGPIO=y
BR2_PACKAGE_PYTHON_PYTZ=y
BR2_PACKAGE_PYTHON_REQUESTS=y
BR2_PACKAGE_PYTHON_SERIAL=y
BR2_PACKAGE_CA_CERTIFICATES=y
BR2_PACKAGE_LIBGCRYPT=y
BR2_PACKAGE_LIBCURL=y
BR2_PACKAGE_LIBCURL_CURL=y
BR2_PACKAGE_LIBCURL_VERBOSE=y
BR2_PACKAGE_LIBDAEMON=y
BR2_PACKAGE_NCURSES_WCHAR=y
BR2_PACKAGE_NCURSES_TARGET_PROGS=y
BR2_PACKAGE_NCURSES_ADDITIONAL_TERMINFO="v/vt100"
BR2_PACKAGE_ARP_SCAN=y
BR2_PACKAGE_AUTOSSH=y
BR2_PACKAGE_CHRONY=y
BR2_PACKAGE_IFTOP=y
BR2_PACKAGE_IPTABLES=y
BR2_PACKAGE_IPTRAF_NG=y
BR2_PACKAGE_OPENRESOLV=y
BR2_PACKAGE_OPENSSH=y
BR2_PACKAGE_RSYNC=y
BR2_PACKAGE_WGET=y
BR2_PACKAGE_WIREGUARD_TOOLS=y
BR2_PACKAGE_WIRELESS_REGDB=y
BR2_PACKAGE_WIRELESS_TOOLS=y
BR2_PACKAGE_WIRELESS_TOOLS_LIB=y
BR2_PACKAGE_WPA_SUPPLICANT=y
BR2_PACKAGE_WPA_SUPPLICANT_AP_SUPPORT=y
BR2_PACKAGE_WPA_SUPPLICANT_WIFI_DISPLAY=y
BR2_PACKAGE_WPA_SUPPLICANT_MESH_NETWORKING=y
BR2_PACKAGE_WPA_SUPPLICANT_AUTOSCAN=y
BR2_PACKAGE_WPA_SUPPLICANT_HOTSPOT=y
BR2_PACKAGE_WPA_SUPPLICANT_DEBUG_SYSLOG=y
BR2_PACKAGE_WPA_SUPPLICANT_WPS=y
BR2_PACKAGE_WPA_SUPPLICANT_WPA3=y
BR2_PACKAGE_WPA_SUPPLICANT_CLI=y
BR2_PACKAGE_WPA_SUPPLICANT_WPA_CLIENT_SO=y
BR2_PACKAGE_WPA_SUPPLICANT_PASSPHRASE=y
BR2_PACKAGE_BASH_COMPLETION=y
BR2_PACKAGE_FILE=y
BR2_PACKAGE_LOGROTATE=y
BR2_PACKAGE_SUDO=y
BR2_PACKAGE_TMUX=y
BR2_PACKAGE_ACL=y
BR2_PACKAGE_DCRON=y
BR2_PACKAGE_PROCPS_NG=y
BR2_PACKAGE_RSYSLOG=y
BR2_PACKAGE_SUPERVISOR=y
BR2_PACKAGE_TAR=y
BR2_PACKAGE_UTIL_LINUX_BINARIES=y
BR2_PACKAGE_UTIL_LINUX_PARTX=y
BR2_PACKAGE_MOST=y
BR2_PACKAGE_NANO=y
BR2_PACKAGE_VIM=y
BR2_TARGET_ROOTFS_EXT2=y
BR2_TARGET_ROOTFS_EXT2_4=y
BR2_TARGET_ROOTFS_EXT2_SIZE="512M"
# BR2_TARGET_ROOTFS_TAR is not set
BR2_PACKAGE_HOST_DOSFSTOOLS=y
BR2_PACKAGE_HOST_GENIMAGE=y
BR2_PACKAGE_HOST_MTOOLS=y
BR2_PACKAGE_DATATRANSPORT=y
BR2_PACKAGE_PYTHON_GPSD_PY3=y
BR2_PACKAGE_PYTHON_PYEPHEM=y
BR2_PACKAGE_PYTHON2_NUMPY=y
BR2_PACKAGE_NFS_UTILS_2=y
BR2_PACKAGE_NFS_UTILS_2_RPCDEBUG=y
BR2_PACKAGE_NFS_UTILS_2_RPC_LOCKD=y
BR2_PACKAGE_NFS_UTILS_2_RPC_RQUOTAD=y
BR2_PACKAGE_NFS_UTILS_2_NFS4=y
BR2_PACKAGE_MGETTY=y
BR2_PACKAGE_DIGITEMP=y
BR2_PACKAGE_UFW=y
BR2_PACKAGE_MDIOTOOL=y
```

## external/package/datatransport/Config.in
```kconfig
config BR2_PACKAGE_DATATRANSPORT
	bool "datatransport" 
	depends on BR2_USE_MMU # fork()
    select BR2_PACKAGE_PYTHON
    select BR2_PACKAGE_INN2
	help
        Data Transport Network

        https://www.datatransport.org
```

## external/package/digitemp/Config.in
```kconfig
config BR2_PACKAGE_DIGITEMP
    bool "digitemp"
    select BR2_PACKAGE_LIBUSB
    select BR2_PACKAGE_LIBUSB_COMPAT
    help
    1-wire DigiTemp program

    http://www.digitemp.com
```

## external/package/inn2/Config.in
```kconfig
config BR2_PACKAGE_INN2
	bool "inn2" 
	depends on BR2_USE_MMU # fork()
    select BR2_PACKAGE_GAWK
    select BR2_PACKAGE_OPENSSL
    select BR2_PACKAGE_BZIP2
    select BR2_PACKAGE_GZIP
    select BR2_PACKAGE_PERL
    select BR2_PACKAGE_PERL_MIME_TOOLS
	help
        INN (InterNetNews) is a very full-featured and flexible 
        news server package.

        https://www.eyrie.org/~eagle/software/inn/
```

## external/package/libnfsidmap/Config.in
```kconfig
config BR2_PACKAGE_LIBNFSIDMAP
	bool "libnfsidmap"
	help
	  Library used by the NFSv4 server to do userid mapping.

	  http://www.citi.umich.edu/projects/nfsv4/linux/libnfsidmap
```

## external/package/mdiotool/Config.in
```kconfig
config BR2_PACKAGE_MDIOTOOL
	bool "mdiotool"
	help
        MDIO tool 

        https://github.com/PieVo/mdio-tool
```

## external/package/mgetty/Config.in
```kconfig
config BR2_PACKAGE_MGETTY
	bool "mgetty"
	help
	  getty

	  http://mgetty.greenie.net/ 
```

## external/package/nfs-utils-2/Config.in
```kconfig
comment "nfs-utils-2 needs a toolchain w/ threads"
	depends on BR2_USE_MMU
	depends on !BR2_TOOLCHAIN_HAS_THREADS

config BR2_PACKAGE_NFS_UTILS_2
	bool "nfs-utils-2"
	depends on BR2_TOOLCHAIN_HAS_THREADS # libtirpc, rpcbind
	depends on BR2_USE_MMU # fork()
	select BR2_PACKAGE_LIBTIRPC if !BR2_TOOLCHAIN_HAS_NATIVE_RPC
	select BR2_PACKAGE_RPCBIND # runtime
	help
	  The NFS Linux kernel server.

	  http://linux-nfs.org/

if BR2_PACKAGE_NFS_UTILS_2

config BR2_PACKAGE_NFS_UTILS_2_RPCDEBUG
	bool "rpcdebug"
	help
	  The RPC debugging utility

config BR2_PACKAGE_NFS_UTILS_2_RPC_LOCKD
	bool "rpc.lockd"
	help
	  NFS lock manager for Linux kernels older than 2.4

config BR2_PACKAGE_NFS_UTILS_2_RPC_RQUOTAD
	bool "rpc.rquotad"
	help
	  NFS remote quota server

config BR2_PACKAGE_NFS_UTILS_2_NFS4
    bool "NFSv4 support"
    depends on BR2_PACKAGE_NFS_UTILS_2
    select BR2_PACKAGE_LIBEVENT
    select BR2_PACKAGE_LIBNFSIDMAP
    select BR2_PACKAGE_KEYUTILS
    select BR2_PACKAGE_LVM2
    help
      Support for NFSv4.  Don't forget to enable the kernel facility also.

endif
```

## external/package/python-gpsd-py3/Config.in
```kconfig
config BR2_PACKAGE_PYTHON_GPSD_PY3
	bool "python-gpsd-py3"
	help
	  Python 3 library for working with gpsd.

	  https://github.com/MartijnBraam/gpsd-py3
```

## external/package/python-pyephem/Config.in
```kconfig
config BR2_PACKAGE_PYTHON_PYEPHEM
	bool "python-pyephem"
	help
	  Compute positions of the planets and stars.

	  http://rhodesmill.org/pyephem/
```

## external/package/rpi-vcgencmd/Config.in
```kconfig
config BR2_PACKAGE_RPI_VCGENCMD
	bool "rpi-vcgencmd"
	depends on BR2_aarch64
	help
          Minimalist build of the Raspberry Pi vcgencmd utility
          and required libraries for AArch64 systems. Based off
          the rpi-userland package.
```

## external/package/set-dynamics-mode/Config.in
```kconfig
config BR2_PACKAGE_SET_DYNAMICS_MODE
    bool "set_dynamics-mode"
    help
    uBlox dynamics mode 
```

## external/package/ts-utils-7250v2/Config.in
```kconfig
config BR2_PACKAGE_TS_UTILS_7250V2
	bool "ts-utils-7250v2"
	help
	  Collection of utility programs for the TS-7250v2 

	  ftp://ftp.embeddedarm.com/ts-arm-sbc/ts-7250-v2-linux/sources/ 
```

## external/package/ufw/Config.in
```kconfig
config BR2_PACKAGE_UFW
	bool "ufw"
	help
	  Uncomplicated firewall 

	  https://wiki.ubuntu.com/UncomplicatedFirewall

if BR2_PACKAGE_UFW

config BR2_PACKAGE_UFW_ENABLED
    bool "enable to run at boot"
    default y
    help
      Run UFW at system boot

endif
```
